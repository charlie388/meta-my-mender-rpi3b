## conf/layer.conf
```bitbake
# We have a conf and classes directory, add to BBPATH
BBPATH .= ":${LAYERDIR}"

# We have recipes-* directories, add to BBFILES
BBFILES += "${LAYERDIR}/recipes-*/*/*.bb \
            ${LAYERDIR}/recipes-*/*/*.bbappend"

BBFILE_COLLECTIONS += "meta-my-mender-rpi3b"
BBFILE_PATTERN_meta-my-mender-rpi3b = "^${LAYERDIR}/"
BBFILE_PRIORITY_meta-my-mender-rpi3b = "11"

LAYERDEPENDS_meta-my-mender-rpi3b = "core"
LAYERSERIES_COMPAT_meta-my-mender-rpi3b = "dunfell"

MENDER_ARTIFACT_NAME = "release-1"
MENDER_DTB_NAME_FORCE = "bcm2710-rpi-3-b-plus.dtb"

INHERIT += "mender-full"
MENDER_FEATURES_ENABLE_append = " mender-uboot mender-image-sd"
MENDER_FEATURES_DISABLE_append = " mender-grub mender-image-uefi mender-growfs-data"
ARTIFACTIMG_FSTYPE = "ext4"
IMAGE_FSTYPES = ""

MENDER_STORAGE_DEVICE = "/dev/mmcblk0"
MENDER_STORAGE_TOTAL_SIZE_MB = "512"
MENDER_BOOT_PART_SIZE_MB = "32"
MENDER_DATA_PART_SIZE_MB = "32"

PREFERRED_RPROVIDER_u-boot-default-env = "libubootenv"

#IMAGE_INSTALL_append = " kernel-image kernel-devicetree"
#SDIMG_ROOTFS_TYPE = "ext4"

#MENDER_SERVER_URL = "https://hosted.mender.io"
#MENDER_TENANT_TOKEN = "eyJhbGciOiJSUzI1NiIsInR5cCI6IkpXVCJ9.eyJtZW5kZXIudGVuYW50IjoiNjMwMzE4YzA5ZDY2ZDI4OGYwZTAyOTE1IiwiaXNzIjoiTWVuZGVyIiwic3ViIjoiNjMwMzE4YzA5ZDY2ZDI4OGYwZTAyOTE1In0.BE8-PHv-_kgQKW02-VeqVeN4nK5ck8WlZ6GYgZwJ0r2ryR7Z4DoJVPoNjtOlVZojoL5bCRc2akfFBHU7iiORtsCY2wQijLHIJqqcy9JLNXUE4ZvzsYuBtXV5BlrxofpPzfNHrX5FY_L5uELRrbvKeMTGf7VEBcAwwGBaHtkfIOzvJGUNaIV8zRrn9O-EOtexL9Ra7ohaW3-7k23UUQx8cbL_BX5AHT9bmzYW4XKCa-5eUatbfcsna0SGIpxStF-r2jwA8e10pEip7TKGDxuC36fUzrse0KOAvjLZea9xnxkbtnftlnN444bBf6HrzR8nIBVfTRE3Mg8SXd-Zh_LZNhl6qM3dB-jsutni0heCT03Wx8XJeGgIh3WRt-HF1tJMIikSzAs3COUMZx2Rkbmai1mGvNIrLA2zh6iP3PMB37giJowQZlNslEvZbcYgHenGYzqAk4F8Ii6p_Y4jITLcxOgpxtpo7jwDxlXVtqseGyx7rdJj3-1T6qM2FVAcDXMn"
MENDER_SERVER_URL = "https://test-mender.com"

MENDER_UPDATE_POLL_INTERVAL_SECONDS = "5"
MENDER_INVENTORY_POLL_INTERVAL_SECONDS = "30"

EXTRA_IMAGE_FEATURES_append = " read-only-rootfs"
```
